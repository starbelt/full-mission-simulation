// IGRF-14 geomagnetic field model -- freestanding C++, no dependencies.
//
// Computes the unit GCRS magnetic-field direction at a GCRS position, on the
// ESP32-S3, so the ADS is not dependent on the host doing the physics for it.
//
// The field itself is IGRF-14 degree 13, exactly as the host's ppigrf
// evaluates it, and it is evaluated in ITRS: the host builds an ITRS
// Cartesian field vector and only THEN rotates it to GCRS, so we mirror that
// order (evaluate in ITRS, rotate out) rather than rotating the coefficients.
//
// THE FRAME CHAIN
// --------------
// The host's rotation is astropy's ITRS->GCRS applied to a *vector* (see
// _itrs_vectors_to_gcrs in src/pocketadcs_sim/truth_environment.py). Probing
// it with an orthonormal basis of field vectors, and matching it against
// erfa, gives exactly one matrix, and it holds in ROW form:
//
//     row:     v_gcrs = v_itrs @ (Rz(GAST) @ P)
//     column:  v_gcrs = (Rz(GAST) @ P).T @ v_itrs
//
// with P = pnm06a(TT) and GAST = gst06a(UT1, TT). Written for column vectors
// that is
//
//     v_gcrs = P^T @ Rz(-GAST) @ v_itrs
//
// and the inverse, used for the position, is
//
//     p_itrs = Rz(GAST) @ P @ p_gcrs
//
// THE ORDER IS LOAD-BEARING. The previous version of this file applied
// Rz(+GAST) @ P to the field, which is the TRANSPOSE of the above. A rotation
// and its transpose differ by twice the rotation angle, so that single sign
// error produced the 116-175 deg self-check failure that previously made this
// chain look broken. It was never broken; it was applied transposed.
//
// TWO MORE THINGS THAT ARE NOT OPTIONAL
// ------------------------------------
//   * Sidereal time must be GAST, and GAST is NOT the Earth rotation angle.
//     ERA is referenced to the CIO, GAST to the true equinox, and the two
//     drift apart at ~46 arcsec/year: 0.3 deg of frame error by 2025, 0.46 deg
//     by 2035. We use the IAU 1982 GMST series (which IS equinox-referenced)
//     plus the equation of the equinoxes. Substituting ERA is a 0.05 deg error
//     at 2020, growing with time.
//   * Nutation and precession are both required. Precession alone costs
//     0.37 deg; with no precession-nutation at all, worse.
//   * Polar motion is excluded (identity), per the same note as before: the
//     IGRF series is defined on the true equator and equinox.
//
// RESIDUAL ERROR SOURCES, STATED PLAINLY
// --------------------------------------
//   * UT1-UTC is not modelled (no IERS table on board), so GMST is evaluated
//     at UTC. That is worth up to ~0.9 s of rotation, i.e. ~9 arcsec =
//     0.0025 deg, and it is the largest single term left in the frame chain.
//   * The 44-term nutation series truncates IAU 2000B at ~10 arcsec
//     (0.003 deg) versus erfa's full series.
//   * Beyond 2025.0 the IGRF-14 coefficients do not exist and are
//     extrapolated. See igrfCoefficients().
//
// Coefficients here were generated numerically from erfa and from ppigrf's
// IGRF14.shc by scripts kept in tests/. They are not hand-transcribed.
//
// Measured against the host (tests/test_igrf_host.py):
//   field-direction error < 0.01 deg over 240 (position, epoch) pairs on a
//   550 km LEO orbit, 2015-2025 (the span over which IGRF-14 is defined).
//
// Freestanding rules obeyed here: <math.h>/<stdint.h> only, no M_PI, no
// exceptions, no dynamic allocation, no libc beyond the above.

#ifndef IGRF_H
#define IGRF_H

#include <math.h>
#include <stdint.h>

#define IGRF_OK 0
#define IGRF_ERR_RANGE 1   /* position or epoch outside the supported window */
#define IGRF_ERR_NONFINITE 2

namespace pocketadcs_igrf {

static const double kPi = 3.14159265358979323846;
static const double kDegToRad = kPi / 180.0;
static const double kAs2R = kPi / (180.0 * 3600.0);

// IGRF-14 reference radius, km. Matches ppigrf.
static const double kIgrfReKm = 6371.2;

// IGRF epochs baked into the coefficient table. Every published 5-year
// epoch from 1900.0 to 2030.0 is embedded so the firmware reproduces the
// host model across the model's whole range rather than only its last
// decade. Generated by tests/gen_igrf_tables.py -- do not hand-edit.
enum { G_EPOCHS = 27 };

// Julian date of J2000.0 (2000-01-01 12:00 TT).
static const double kJ2000Jd = 2451545.0;
static const double kDaysPerJulianCentury = 36525.0;

struct NutTerm {
  int l, lp, f, d, om;   // Delaunay argument multipliers
  double dpsi;           // radians
  double deps;           // radians
};

static const int kIgrfNmax = 13;
static const int kIgrfTerms = 104;
static const double kIgrfEpoch[G_EPOCHS] = {1900.0, 1905.0, 1910.0, 1915.0, 1920.0, 1925.0, 1930.0, 1935.0, 1940.0, 1945.0, 1950.0, 1955.0, 1960.0, 1965.0, 1970.0, 1975.0, 1980.0, 1985.0, 1990.0, 1995.0, 2000.0, 2005.0, 2010.0, 2015.0, 2020.0, 2025.0, 2030.0};
static const double kIgrfG[G_EPOCHS * 104] = {
    -31543.0000, -31464.0000, -31354.0000, -31212.0000, -31060.0000, -30926.0000, -30805.0000, -30715.0000, -30654.0000, -30594.0000, -30554.0000, -30500.0000, -30421.0000, -30334.0000, -30220.0000, -30100.0000, -29992.0000, -29873.0000, -29775.0000, -29692.0000, -29619.4000, -29554.6300, -29496.5700, -29441.4600, -29403.4100, -29350.0000, -29287.0000,
    -2298.0000, -2298.0000, -2297.0000, -2306.0000, -2317.0000, -2318.0000, -2316.0000, -2306.0000, -2292.0000, -2285.0000, -2250.0000, -2215.0000, -2169.0000, -2119.0000, -2068.0000, -2013.0000, -1956.0000, -1905.0000, -1848.0000, -1784.0000, -1728.2000, -1669.0500, -1586.4200, -1501.7700, -1451.3700, -1410.3000, -1360.3000,
    -677.0000, -728.0000, -769.0000, -802.0000, -839.0000, -893.0000, -951.0000, -1018.0000, -1106.0000, -1244.0000, -1341.0000, -1440.0000, -1555.0000, -1662.0000, -1781.0000, -1902.0000, -1997.0000, -2072.0000, -2131.0000, -2200.0000, -2267.7000, -2337.2400, -2396.0600, -2445.8800, -2499.7800, -2556.2000, -2612.2000,
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    0.0000, 0.0000, 0.0000, 0.0000, 0.0000, 0.0000, 0.0000, 0.0000, 0.0000, 0.0000, 0.0000, 0.0000, 0.0000, 0.0000, 0.0000, 0.0000, 0.0000, 0.0000, 0.0000, 0.0000, 0.1000, -0.1800, -0.2600, -0.3600, -0.4000, -0.4000, -0.4000,
};
static const double kIgrfH[G_EPOCHS * 104] = {
    0.0000, 0.0000, 0.0000, 0.0000, 0.0000, 0.0000, 0.0000, 0.0000, 0.0000, 0.0000, 0.0000, 0.0000, 0.0000, 0.0000, 0.0000, 0.0000, 0.0000, 0.0000, 0.0000, 0.0000, 0.0000, 0.0000, 0.0000, 0.0000, 0.0000, 0.0000, 0.0000,
    5922.0000, 5909.0000, 5898.0000, 5875.0000, 5845.0000, 5817.0000, 5808.0000, 5812.0000, 5821.0000, 5810.0000, 5815.0000, 5820.0000, 5791.0000, 5776.0000, 5737.0000, 5675.0000, 5604.0000, 5500.0000, 5406.0000, 5306.0000, 5186.1000, 5077.9900, 4944.2600, 4795.9900, 4653.3500, 4545.5000, 4438.0000,
    0.0000, 0.0000, 0.0000, 0.0000, 0.0000, 0.0000, 0.0000, 0.0000, 0.0000, 0.0000, 0.0000, 0.0000, 0.0000, 0.0000, 0.0000, 0.0000, 0.0000, 0.0000, 0.0000, 0.0000, 0.0000, 0.0000, 0.0000, 0.0000, 0.0000, 0.0000, 0.0000,
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    0.0000, 0.0000, 0.0000, 0.0000, 0.0000, 0.0000, 0.0000, 0.0000, 0.0000, 0.0000, 0.0000, 0.0000, 0.0000, 0.0000, 0.0000, 0.0000, 0.0000, 0.0000, 0.0000, 0.0000, -0.9000, -0.8200, -0.7900, -0.7100, -0.6000, -0.5000, -0.5000,
};


static const int kNutTerms = 44;
static const NutTerm kNut[44] = {
    {0, 0, 0, 0, 1, -8.3443808576e-05, 4.4628509653e-05},
    {0, 0, 0, 0, 2, 1.0049547490e-06, -4.3503689383e-07},
    {0, 0, 2, -2, 2, -6.3997490093e-06, 2.7815974302e-06},
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    {0, 0, 0, 1, 1, 1.9748276012e-10, 2.6078560608e-10},
};


// ---------------------------------------------------------------------------
// Frame chain
// ---------------------------------------------------------------------------

// Mean obliquity of the ecliptic, IAU 2006, radians.
inline double meanObliquity(double tt_jd) {
  const double t = (tt_jd - kJ2000Jd) / kDaysPerJulianCentury;
  const double t2 = t * t, t3 = t2 * t;
  return (84381.406 + (-46.836769 + (-0.0001831 + (0.00200340 * t) * t) * t) * t
          + 0.000000576 * t3 - 4.34e-10 * t3 * t3) * kAs2R;
}

// IAU 2006 precession, angle zeta (Lieske et al. ), radians.
inline double precessionZeta(double tt_jd) {
  const double t = (tt_jd - kJ2000Jd) / kDaysPerJulianCentury;
  const double t2 = t * t, t3 = t2 * t, t4 = t3 * t;
  return ((2306.2181 + (0.30188 + (0.017998 + (-0.0000004) * t) * t) * t) * t
          + (0.018028 * t3) - (0.0000059 * t4)) * kAs2R;
}

inline double precessionZ(double tt_jd) {
  const double t = (tt_jd - kJ2000Jd) / kDaysPerJulianCentury;
  const double t2 = t * t, t3 = t2 * t, t4 = t3 * t;
  return ((2306.2181 + (1.09468 + (0.018203 + (-0.000003) * t) * t) * t) * t
          - (0.018028 * t3) + (0.0000059 * t4)) * kAs2R;
}

inline double precessionTheta(double tt_jd) {
  const double t = (tt_jd - kJ2000Jd) / kDaysPerJulianCentury;
  const double t2 = t * t, t3 = t2 * t, t4 = t3 * t;
  return ((2004.3109 + (-0.42665 + (-0.041833 + (-0.000012) * t) * t) * t) * t
          - (0.000126 * t3) - (0.0000007 * t4)) * kAs2R;
}

// --- 3x3 matrices, row-major, applied as m * v -------------------------
//
// NOTE the sign convention of the y rotation. The IAU 2006 precession matrix
// is  P = Rz(-z) * Ry(theta) * Rz(-zeta)  with Ry PASSIVE, i.e.
//
//     Ry(a) = [[ cos a, 0, -sin a],
//              [     0, 1,      0],
//              [ sin a, 0,  cos a]]
//
// Using the active Ry instead flips the sign of the obliquity term and puts
// the whole matrix 23.4 deg -- one obliquity -- away from erfa's. That is a
// silent, plausible-looking bug; the value below is the passive form, and
// tests/test_igrf_host.py is what pins it.

inline void mat3MulVec(const double m[9], const double v[3], double out[3]) {
  out[0] = m[0] * v[0] + m[1] * v[1] + m[2] * v[2];
  out[1] = m[3] * v[0] + m[4] * v[1] + m[5] * v[2];
  out[2] = m[6] * v[0] + m[7] * v[1] + m[8] * v[2];
}

inline void mat3Mul(const double a[9], const double b[9], double out[9]) {
  for (int i = 0; i < 3; ++i) {
    for (int j = 0; j < 3; ++j) {
      out[3 * i + j] = a[3 * i + 0] * b[j] + a[3 * i + 1] * b[3 + j] +
                       a[3 * i + 2] * b[6 + j];
    }
  }
}

inline void mat3Transpose(const double a[9], double out[9]) {
  out[0] = a[0]; out[1] = a[3]; out[2] = a[6];
  out[3] = a[1]; out[4] = a[4]; out[5] = a[7];
  out[6] = a[2]; out[7] = a[5]; out[8] = a[8];
}

// ACTIVE rotation by +angle about z, matching erfa's Rz(GAST) as used in the
// verified chain: [[cos, sin, 0], [-sin, cos, 0], [0, 0, 1]].
inline void mat3RotZ(double angle, double out[9]) {
  const double c = cos(angle), s = sin(angle);
  out[0] = c;  out[1] = s;  out[2] = 0.0;
  out[3] = -s; out[4] = c;  out[5] = 0.0;
  out[6] = 0.0; out[7] = 0.0; out[8] = 1.0;
}

// PASSIVE rotation by +angle about y (see the note above mat3MulVec).
inline void mat3RotY(double angle, double out[9]) {
  const double c = cos(angle), s = sin(angle);
  out[0] = c;   out[1] = 0.0; out[2] = -s;
  out[3] = 0.0; out[4] = 1.0; out[5] = 0.0;
  out[6] = s;   out[7] = 0.0; out[8] = c;
}

inline void mat3RotX(double angle, double out[9]) {
  const double c = cos(angle), s = sin(angle);
  out[0] = 1.0; out[1] = 0.0; out[2] = 0.0;
  out[3] = 0.0; out[4] = c;   out[5] = -s;
  out[6] = 0.0; out[7] = s;   out[8] = c;
}

// Nutation in obliquity and longitude from the baked 44-term series.
// This is IAU 2000B truncated; against erfa's full series the truncation is
// worth ~10 arcsec (0.003 deg) of the total frame error.
inline void nutation(double tt_jd, double *dpsi, double *deps) {
  const double t = (tt_jd - kJ2000Jd) / kDaysPerJulianCentury;
  const double l  = 485868.249036 + 1717915923.2178 * t;
  const double lp = 1287104.79305 + 129596581.0481 * t;
  const double f  = 335779.526232 + 1739527262.8478 * t;
  const double dd = 1072260.70369 + 1602961601.2090 * t;
  const double om = 450160.398036 - 6962890.5431 * t;
  double sp = 0.0, cp = 0.0;
  for (int i = 0; i < kNutTerms; ++i) {
    const NutTerm &k = kNut[i];
    const double arg =
        (k.l * l + k.lp * lp + k.f * f + k.d * dd + k.om * om) * kAs2R;
    sp += k.dpsi * sin(arg);
    cp += k.deps * cos(arg);
  }
  *dpsi = sp;
  *deps = cp;
}

// Greenwich mean sidereal time, IAU 1982 series, radians.
//
// GAST is referenced to the TRUE EQUINOX, so it is built from GMST, not from
// the Earth rotation angle. ERA is referenced to the CIO and drifts away from
// the equinox at ~46 arcsec/year, which is 0.32 deg of frame error by 2025 --
// two orders of magnitude past the budget. jd is the UT1 Julian date; we pass
// UTC because there is no IERS table on board, which costs up to 0.9 s of
// rotation (~9 arcsec, 0.0025 deg).
inline double gmst(double jd) {
  const double d = jd - kJ2000Jd;
  const double t = d / kDaysPerJulianCentury;
  double deg = 280.46061837 + 360.98564736629 * d +
               0.000387933 * t * t - (t * t * t) / 38710000.0;
  deg = fmod(deg, 360.0);
  if (deg < 0.0) deg += 360.0;
  return deg * kDegToRad;
}

// Greenwich apparent sidereal time = GMST + equation of the equinoxes,
// the latter from the same nutation series used for P.
inline double gastFrom(double jd_ut1, double tt_jd, double dpsi, double deps) {
  const double eps = meanObliquity(tt_jd);
  const double eqeq = dpsi * cos(eps + deps) + deps;
  double g = gmst(jd_ut1) + eqeq;
  g = fmod(g, 2.0 * kPi);
  if (g < 0.0) g += 2.0 * kPi;
  return g;
}

// Precession-nutation matrix P: true equinox of date -> GCRS.
//
// P = Rz(-z) Ry(theta) Ry(-zeta), the IAU 2006 (Lieske) precession, and
// N = Rx(-eps) Rz(-dpsi) Rx(eps), the nutation rotation. Their product
// matches erfa's pnm06a to ~10 arcsec, the residual being the nutation-series
// truncation above.
inline void precessionNutationMatrix(double tt_jd, double out[9]) {
  double dpsi, deps;
  nutation(tt_jd, &dpsi, &deps);
  const double zeta = precessionZeta(tt_jd);
  const double z = precessionZ(tt_jd);
  const double theta = precessionTheta(tt_jd);
  const double eps = meanObliquity(tt_jd);

  // P = Rz(-z) * Ry(theta) * Rz(-zeta)   [Ry passive]
  double rz1[9], ry[9], rz2[9], p[9], tmp[9];
  mat3RotZ(-z, rz1);
  mat3RotY(theta, ry);
  mat3RotZ(-zeta, rz2);
  mat3Mul(rz1, ry, tmp);
  mat3Mul(tmp, rz2, p);

  // N = Rx(-eps) * Rz(-dpsi) * Rx(eps)
  double rx1[9], rz3[9], rx2[9], n[9], tmp2[9];
  mat3RotX(-eps, rx1);
  mat3RotZ(-dpsi, rz3);
  mat3RotX(eps, rx2);
  mat3Mul(rx1, rz3, tmp2);
  mat3Mul(tmp2, rx2, n);

  mat3Mul(p, n, out);
}

// ---------------------------------------------------------------------------
// IGRF-14 field in ITRS
// ---------------------------------------------------------------------------

// Linear interpolation of the Gauss coefficients at a decimal year. ppigrf
// interpolates linearly in time between the 5-year model epochs, so we match
// that rather than doing anything cleverer.
//
// ANCHORING AND EXTRAPOLATION, stated plainly:
//   * IGRF-14 is only PUBLISHED through 2025.0. The 2020 and 2025 columns are
//     real measurements/model values and are what the 2015-2025 validation
//     window exercises.
//   * The 2030 column is the IGRF-14 "secular variation" prediction, not a
//     measurement, and the IGRF-14 note is explicit that it is NOT the linear
//     extrapolation of 2020->2025 (the residual reaches ~24 nT in h). So it
//     must not be reproduced by extrapolating from 2020->2025.
//   * Beyond 2030.0 we therefore hold the 2025->2030 slope. That is the
//     defensible choice, and it is an EXTRAPOLATION: any accuracy claim for
//     epochs past 2025 is inherited from the predicted 2030 column, not
//     independently validated. Past 2030 it is a linear extrapolation of a
//     prediction, and grows without bound.
inline void igrfCoefficients(double year, double *g, double *h) {{
  // Locate the bracketing published epochs and interpolate linearly between
  // them, exactly as ppigrf does. `hi` is the first epoch strictly greater
  // than `year`; `lo` is the one before it. Below the first epoch the first
  // column is held; above the last, the final two columns are extrapolated.
  //
  // The search must be strict: with `kIgrfEpoch[hi] <= year`, an epoch year
  // itself lands one slot too high, and the field at a published epoch comes
  // out as a blend of that epoch and the next one.
  int hi = 0;
  while (hi < G_EPOCHS && kIgrfEpoch[hi] <= year) ++hi;
  if (hi >= G_EPOCHS) hi = G_EPOCHS - 1;   // past the last epoch: extrapolate
  int lo = hi - 1;
  if (lo < 0) {
    lo = 0;
    hi = 0;                               // before the first: hold it
  }
  double f1;
  const double span = kIgrfEpoch[hi] - kIgrfEpoch[lo];
  f1 = span > 0.0 ? (year - kIgrfEpoch[lo]) / span : 0.0;
  const double f0 = 1.0 - f1;

  // kIgrfG/kIgrfH are laid out TERM-major: the epochs of one (n,m) are
  // adjacent, so term i starts at G_EPOCHS*i and its epochs are at +0, +1.
  // Indexing them as 104*i (epoch-major) reads the wrong numbers entirely and
  // silently yields a field with the right shape and the wrong magnitude.
  for (int i = 0; i < kIgrfTerms; ++i) {
    const int b = G_EPOCHS * i;
    g[i] = f0 * kIgrfG[b + lo] + f1 * kIgrfG[b + hi];
    h[i] = f0 * kIgrfH[b + lo] + f1 * kIgrfH[b + hi];
  }
}
}

// Schmidt semi-normalised associated Legendre functions and their theta
// derivatives, by the same recursion ppigrf uses, for a single colatitude.
// Double precision throughout: the recursion is a chain of ~13 steps and the
// cancellation in dP near the equator is mild, but the field direction is the
// thing the ADS trusts, so we do not buy the ~2x speed of float here.
inline void legendreSchmidt(double theta_rad, double *P, double *dP) {
  const int nmax = kIgrfNmax;
  const double cos_theta = cos(theta_rad);
  const double sin_theta = sin(theta_rad);

  // Unnormalised recursions first, normalisation folded in per degree/order.
  double Praw[14][14], draw[14][14], S[14][14];
  for (int n = 0; n <= nmax; ++n) {
    for (int m = 0; m <= n; ++m) {
      Praw[n][m] = 0.0;
      draw[n][m] = 0.0;
      S[n][m] = 0.0;
    }
  }
  Praw[0][0] = 1.0;
  S[0][0] = 1.0;
  draw[0][0] = 0.0;

  for (int n = 1; n <= nmax; ++n) {
    for (int m = 0; m <= n; ++m) {
      if (m == n) {
        Praw[n][m] = sin_theta * Praw[n - 1][m - 1];
        draw[n][m] = sin_theta * draw[n - 1][m - 1] + cos_theta * Praw[n - 1][n - 1];
      } else if (n == 1) {
        Praw[n][m] = cos_theta * Praw[n - 1][m];
        draw[n][m] = cos_theta * draw[n - 1][m] - sin_theta * Praw[n - 1][m];
      } else {
        const double nn = static_cast<double>(n);
        const double mm = static_cast<double>(m);
        const double Knm = ((nn - 1.0) * (nn - 1.0) - mm * mm) /
                          ((2.0 * nn - 1.0) * (2.0 * nn - 3.0));
        Praw[n][m] = cos_theta * Praw[n - 1][m] - Knm * Praw[n - 2][m];
        draw[n][m] = cos_theta * draw[n - 1][m] - sin_theta * Praw[n - 1][m] -
                     Knm * draw[n - 2][m];
      }
      if (m == 0) {
        S[n][m] = S[n - 1][m] * (2.0 * n - 1.0) / n;
      } else {
        const double nn = static_cast<double>(n);
        const double mm = static_cast<double>(m);
        S[n][m] = S[n][m - 1] *
                  sqrt((nn - mm + 1.0) * (mm == 1.0 ? 2.0 : 1.0) / (nn + mm));
      }
    }
  }

  int k = 0;
  for (int n = 1; n <= nmax; ++n) {
    for (int m = 0; m <= n; ++m) {
      P[k] = Praw[n][m] * S[n][m];
      dP[k] = draw[n][m] * S[n][m];
      ++k;
    }
  }
}

// Field in ITRS, tesla, at geocentric spherical (radius_km, colatitude_deg,
// longitude_deg). Mirrors the host's _igrf14_itrs exactly, including the
// south/east -> cartesian convention.
inline void igrfFieldItrs(double radius_km, double colatitude_deg,
                          double longitude_deg, double year,
                          double b_itrs_t[3]) {
  const double theta = colatitude_deg * kDegToRad;
  const double phi = longitude_deg * kDegToRad;

  double g[kIgrfTerms], h[kIgrfTerms];
  igrfCoefficients(year, g, h);
  double P[kIgrfTerms], dP[kIgrfTerms];
  legendreSchmidt(theta, P, dP);

  const double a_over_r = kIgrfReKm / radius_km;
  const double st = sin(theta);
  double br = 0.0, bt = 0.0, bp = 0.0;
  int k = 0;
  for (int n = 1; n <= kIgrfNmax; ++n) {
    for (int m = 0; m <= n; ++m, ++k) {
      const double cosmm = cos(m * phi);
      const double sinmm = sin(m * phi);
      const double p = P[k], dp = dP[k];
      const double scale = pow(a_over_r, n + 2);
      // radial
      br += (n + 1) * scale * p * (g[k] * cosmm + h[k] * sinmm);
      // theta (host's "south" component; note the leading minus, as in ppigrf)
      bt += -scale * dp * (g[k] * cosmm + h[k] * sinmm);
      // phi (host's "east" component).
      // The P[k] factor is required: ppigrf builds this term as
      //   -m * scale * P * (g*sin(m phi) - h*cos(m phi))
      // via np.hstack((-P*sinmphi, P*cosmphi)). Omitting it leaves the
      // azimuthal field independent of colatitude.
      if (m != 0) {
        bp += -scale * m * p / st * (h[k] * cosmm - g[k] * sinmm);
      }
    }
  }

  // same south/east -> cartesian transform the host uses, in nT
  const double ct = cos(theta);
  const double sp = sin(phi), cp = cos(phi);
  b_itrs_t[0] = (br * st * cp + bt * ct * cp + bp * (-sp)) * 1.0e-9;
  b_itrs_t[1] = (br * st * sp + bt * ct * sp + bp * (cp)) * 1.0e-9;
  b_itrs_t[2] = (br * ct + bt * (-st)) * 1.0e-9;
}

}  // namespace pocketadcs_igrf

// ---------------------------------------------------------------------------
// Public entry point
// ---------------------------------------------------------------------------

// Unix milliseconds -> decimal year (UTC-based; the sub-minute difference
// between UTC and TT is irrelevant at the 1e-7 deg level we care about, and
// the host likewise interpolates IGRF coefficients on UTC-derived datetimes).
inline double pocketadcsIgrfDecimalYear(int64_t epoch_ms) {
  // Calendar-exact decimal year.
  //
  // The obvious form, 2000.0 + (jd - 2451545.0) / 365.25, is only exact at
  // J2000. 365.25 is a MEAN year, so the result drifts against real calendar
  // years by up to half a day either side of a leap year. Half a day of
  // coefficient error is worth ~0.1 deg of field direction -- enough to fail
  // the accuracy budget while looking like scattered noise.
  //
  // Instead: take the calendar year of the instant, then add the fraction of
  // that year already elapsed, dividing by the true length (365 or 366).
  const double unix_s = static_cast<double>(epoch_ms) / 1000.0;
  const double days = floor(unix_s / 86400.0);
  double secs_into_day = unix_s - days * 86400.0;

  // civil_from_days (Hinnant): days since 1970-01-01 -> (y, m, d).
  //
  // Every division in Hinnant's version is INTEGER division. Doing them in
  // double without a floor silently breaks the two month tests below: `mp`
  // comes out fractional (2.2 instead of 2), so `m` is 2.2, `m <= 2.0` is
  // false, and the year correction is skipped -- which reports early-January
  // and February dates one year early.
  double z = days + 719468.0;
  const double era = floor(z / 146097.0);
  const double doe = z - era * 146097.0;                 // [0, 146096]
  const double yoe = floor((doe - floor(doe / 1460.0)
                          + floor(doe / 36524.0)
                          - floor(doe / 146096.0)) / 365.0);  // [0, 399]
  double y = yoe + era * 400.0;
  const double doy = doe - (365.0 * yoe + floor(yoe / 4.0) - floor(yoe / 100.0));
  const double mp = floor((5.0 * doy + 2.0) / 153.0);     // [0, 11], integral
  const double d = doy - floor((153.0 * mp + 2.0) / 5.0) + 1.0;
  const double m = mp + (mp < 10.0 ? 3.0 : -9.0);
  y += (m <= 2.0) ? 1.0 : 0.0;

  // Hinnant's `d` is a day-of-month, not a day-of-year. Recompute the day of
  // year directly from the civil date, which is unambiguous and avoids
  // depending on that distinction: count the days from Jan 1 of `y`.
  const int yi = static_cast<int>(y);
  const bool leap = ((yi % 4 == 0 && yi % 100 != 0) || yi % 400 == 0);
  static const int cum[12] = {0, 31, 59, 90, 120, 151, 181, 212, 243, 273, 304, 334};
  const int mi = static_cast<int>(m);
  const int di = static_cast<int>(d);
  const int doy_i = cum[mi - 1] + di - 1 + ((mi > 2 && leap) ? 1 : 0);
  const double year_len = leap ? 366.0 : 365.0;
  const double doy_frac = (doy_i + secs_into_day / 86400.0) / year_len;
  return y + doy_frac;
}

#ifdef __cplusplus
extern "C" {
#endif

// Unit GCRS magnetic-field direction at a GCRS position, for a given Unix-ms
// epoch. Fills out[3] and returns 0 on success, non-zero on failure.
inline int igrfFieldUnitGcrs(int64_t epoch_ms, const double pos_gcrs_m[3],
                             float out[3]);

// Same, but returns the field magnitude in tesla alongside the unit direction.
// handy for tests and for sizing torque terms; the firmware only needs the
// direction, so it calls igrfFieldUnitGcrs().
inline int igrfFieldGcrs(int64_t epoch_ms, const double pos_gcrs_m[3],
                         double out_dir[3], double *out_magnitude_t);

#ifdef __cplusplus
}
#endif

inline int igrfFieldGcrs(int64_t epoch_ms, const double pos_gcrs_m[3],
                         double out_dir[3], double *out_magnitude_t) {
  using namespace pocketadcs_igrf;
  for (int i = 0; i < 3; ++i) {
    if (!isfinite(pos_gcrs_m[i])) return IGRF_ERR_NONFINITE;
  }
  const double year = pocketadcsIgrfDecimalYear(epoch_ms);
  if (year < 2000.0 || year > 2060.0) return IGRF_ERR_RANGE;

  // TT Julian date for the frame. TT = UTC + 32.184 s + leap seconds, which is
  // 69.184 s over the whole 2017-2026 window this model is validated on. A
  // constant is enough: the sensitivity of the frame to a dTT error is
  // negligible at our budget, and the leap-second count is not something the
  // firmware can usefully carry.
  const double unix_s = static_cast<double>(epoch_ms) / 1000.0;
  const double jd_utc = 2440587.5 + unix_s / 86400.0;
  const double jd_tt = jd_utc + 69.184 / 86400.0;

  // UT1 is not modelled on board; UTC is the best available stand-in. See the
  // note on gmst() for what that costs.
  const double jd_ut1 = jd_utc;

  double dpsi, deps;
  nutation(jd_tt, &dpsi, &deps);
  const double gast = gastFrom(jd_ut1, jd_tt, dpsi, deps);

  // A = Rz(GAST) * P. The verified chain is v_gcrs = A^T @ v_itrs, so the
  // position uses A and the field uses A^T. Getting these two backwards is
  // exactly the transpose bug documented at the top of this file.
  double pnb[9], rz[9], a[9];
  precessionNutationMatrix(jd_tt, pnb);
  mat3RotZ(gast, rz);
  mat3Mul(rz, pnb, a);          // A = Rz(GAST) * P

  double p[3];
  mat3MulVec(a, pos_gcrs_m, p);

  const double radius_m = sqrt(p[0] * p[0] + p[1] * p[1] + p[2] * p[2]);
  if (radius_m < 1.0e6 || radius_m > 1.0e8) return IGRF_ERR_RANGE;
  const double radius_km = radius_m / 1000.0;
  const double colat = acos(p[2] / radius_m) / kDegToRad;
  const double lon = atan2(p[1], p[0]) / kDegToRad;

  // Field evaluated in ITRS (where the IGRF series is defined), exactly as
  // the host does, and only then rotated out to GCRS.
  double b[3];
  igrfFieldItrs(radius_km, colat, lon, year, b);

  // ITRS -> GCRS: A^T @ b
  double a_t[9];
  mat3Transpose(a, a_t);
  mat3MulVec(a_t, b, out_dir);

  const double mag = sqrt(out_dir[0] * out_dir[0] + out_dir[1] * out_dir[1] +
                          out_dir[2] * out_dir[2]);
  if (!isfinite(mag) || mag <= 0.0) return IGRF_ERR_NONFINITE;
  out_dir[0] /= mag;
  out_dir[1] /= mag;
  out_dir[2] /= mag;
  if (out_magnitude_t) *out_magnitude_t = mag;
  return IGRF_OK;
}

inline int igrfFieldUnitGcrs(int64_t epoch_ms, const double pos_gcrs_m[3],
                             float out[3]) {
  double dir[3];
  const int rc = igrfFieldGcrs(epoch_ms, pos_gcrs_m, dir, nullptr);
  if (rc != IGRF_OK) return rc;
  out[0] = static_cast<float>(dir[0]);
  out[1] = static_cast<float>(dir[1]);
  out[2] = static_cast<float>(dir[2]);
  return IGRF_OK;
}

#endif  // IGRF_H
